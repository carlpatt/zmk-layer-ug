## dts/bindings/behaviors/zmk,behavior-layer-ug.yaml
```yaml
# Copyright (c) 2026 The ZMK Contributors
# SPDX-License-Identifier: MIT

description: Three-state layer + solid underglow color toggle on one key

compatible: "zmk,behavior-layer-ug"

include: behavior-metadata.yaml

properties:
  label:
    type: string
    required: false
    deprecated: true
  "#binding-cells":
    type: int
    required: true
    const: 2
  lower-hsb:
    type: array
    required: true
  raise-hsb:
    type: array
    required: true

binding-cells:
  - param1  # LOWER layer id
  - param2  # RAISE layer id
```
